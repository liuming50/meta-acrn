## conf/layer.conf
```bitbake
# We have a conf and classes directory, add to BBPATH
BBPATH .= ":${LAYERDIR}"

# We have recipes-* directories, add to BBFILES
BBFILES += "${LAYERDIR}/recipes-*/*/*.bb \
        ${LAYERDIR}/recipes-*/*/*.bbappend"

BBFILE_COLLECTIONS += "acrn-layer"
BBFILE_PATTERN_acrn-layer := "^${LAYERDIR}/"
BBFILE_PRIORITY_acrn-layer = "9"

# This should only be incremented on significant changes that will
# cause compatibility issues with other layers
LAYERVERSION_acrn-layer = "1"
LAYERSERIES_COMPAT_acrn-layer = "thud warrior"

LAYERDEPENDS_acrn-layer = "core intel openembedded-layer meta-python"
```

## conf/machine/apl-nuc.conf
```bitbake
require conf/machine/intel-corei7-64.conf
require conf/machine/include/acrn-common.inc
require conf/machine/include/uefi-common.inc

# SOS kernel config
KERNEL_DEFCONFIG ??= "kernel_config_uefi_sos"

ACRN_LINUX_UOS_IMAGES ?= "uos-image-weston"
ACRN_LINUX_UOS_IMAGETYPES ?= "wic"
```

## conf/machine/include/acrn-common.inc
```bitbake
# Use systemd for system initialization
DISTRO_FEATURES_append = " systemd"
DISTRO_FEATURES_BACKFILL_CONSIDERED += "sysvinit"
VIRTUAL-RUNTIME_init_manager = "systemd"
VIRTUAL-RUNTIME_initscripts = "systemd-compat-units"

PREFERRED_PROVIDER_virtual/kernel = "linux-acrn"

ACRN_LINUX_UOS_IMAGES ??= ""
ACRN_ANDROID_UOS_IMAGES ??= ""
ACRN_RTOS_UOS_IMAGES ??= ""
```

## conf/machine/include/uefi-common.inc
```bitbake
ACRN_PLATFORM ??= "uefi"

ACRN_UEFI_ARCH ?= "${@['ia32', 'x64'][d.getVar('TARGET_ARCH') == 'x86_64']}"
ACRN_UEFI_IMAGE_NAME ?= "boot${ACRN_UEFI_ARCH}"
ACRN_UEFI_OS_LOADER_DIR ?= "${@['GRUB', 'SYSTEMD'][d.getVar('EFI_PROVIDER') == 'systemd-boot']}"
ACRN_UEFI_OS_LOADER_NAME ?= "${@['grub-efi', 'systemd'][d.getVar('EFI_PROVIDER') == 'systemd-boot']}-${ACRN_UEFI_IMAGE_NAME}"
```

## scripts/lib/wic/canned-wks/acrn-grub-bootdisk-microcode.wks
```
# short-description: Create an EFI disk image with grub-efi
# long-description: Creates a partitioned EFI disk image that the user
# can directly dd to boot media. The selected bootloader is grub-efi.
# It also includes intel-microcode as an initrd for early update support.

part /boot --source bootimg-efi --sourceparams="loader=grub-efi,initrd=microcode.cpio,title='EFI ACRN Loader'" --ondisk sda --label msdos --active --align 1024 --use-uuid

part / --source rootfs --ondisk sda --fstype=ext4 --label platform --align 1024 --use-uuid

part swap --ondisk sda --size 44 --label swap1 --fstype=swap --use-uuid

bootloader --ptable gpt --timeout=5 --append="rw rootwait rootfstype=ext4 pci_devices_ignore=(0:18:1) console=tty0 console=ttyS0 i915.nuclear_pageflip=1 ignore_loglevel no_timer_check consoleblank=0 i915.tsd_init=7 i915.tsd_delay=2000 i915.avail_planes_per_pipe=0x01010F i915.domain_plane_owners=0x011111110000 i915.enable_guc_loading=0 i915.enable_guc_submission=0 i915.enable_preemption=1 i915.context_priority_mode=2 i915.enable_gvt=1 i915.enable_initial_modeset=1 i915.enable_guc=0 hvlog=2M@0x1FE00000"
```
